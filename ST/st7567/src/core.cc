#include "core.h"
#include "common.h"

const int data_size = 600;
const int channels = 2;
const int c_size = channels*data_size;
uint16_t c[c_size] = {};
uint8_t sss[32] = "";
uint8_t uart1_rxbuf[60]="NO DATA NOW";






/********************金逸晨**************************本公司模块SDA,SCK已内置上拉电阻，
*****************GM12864-59N  4PIN IIC LCD FOR STM32F103*************
*****STM32F103驱动**************************
***** PB5----3  SCK   ,  PB6----4  SDA   ,
***** BY:GU
********************************************************/


#define IIC_SCK_PIN 5
#define IIC_SDA_PIN 6

#define LCD_DIS_CHINA_ROT  0
#define LCD_COMMAND_NUMBER  16
#define LCD_COLUMN_NUMBER 128
#define LCD_LINE_NUMBER 64
#define LCD_COLUMN_OFFSET 0
#define LCD_PAGE_NUMBER LCD_LINE_NUMBER/8
/**********SPI引脚分配，连接LCD屏，更具实际情况修改*********/

#define IIC_SCK_0  GPIOB->BSRR=0X0000       // 设置sck接口到PB5   清零
#define IIC_SCK_1  GPIOB->BSRR=0X0020       //置位
#define IIC_SDA_0  GPIOB->BSRR=0X0000       // 设置SDA接口到PB6
#define IIC_SDA_1  GPIOB->BSRR=0X0040

unsigned char ACK=0;
const unsigned char  LCD_init_cmd[LCD_COMMAND_NUMBER]=
{
       0xe2, //软复位

	0x2c, //升压步聚1
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	0xa2, //1/9 偏压比（bias）
	#if (LCD_DIS_CHINA_ROT == 180)
	0xA1, //列扫描顺序：从左到右
	0xc0, //行扫描顺序：反序
	#else
	0xA0, //列扫描顺序：从左到右
	0xc8, //行扫描顺序：反序
	#endif

	0xa6, //正显
	0x40, //起始行：第一行开始
	0xaf, //开显示
};
unsigned char  picture_tab[]={
/*------------------------------------------------------------------------------
;  列行式，低位在前，阴码
;  宽×高（像素）: 128×64
------------------------------------------------------------------------------*/
    0xFF,0x01,0x01,0x01,0x01,0x01,0x01,0x01,0x01,0x01,0x01,0x01,0x01,0x01,0x01,0x01,
0x01,0x01,0x01,0x01,0x01,0x01,0x01,0x01,0x01,0x01,0x01,0x01,0x01,0x01,0x01,0x01,
0x01,0x01,0x01,0x01,0x01,0x01,0x01,0x01,0x01,0x01,0x01,0x01,0x01,0x01,0x01,0x01,
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0x80,0x80,0x80,0x80,0x80,0x80,0x80,0x80,0x80,0x80,0x80,0x80,0x80,0x80,0x80,0xFF

};

/*******时钟初始化******************/
void SYS_init(unsigned char PLL)
{


	RCC->APB1RSTR = 0x00000000;//复位结束
	RCC->APB2RSTR = 0x00000000;
  	RCC->AHB1ENR = 0x00000014;  //睡眠模式闪存和SRAM时钟使能.其他关闭.
  	RCC->APB2ENR = 0x00000000; //外设时钟关闭.
  	RCC->APB1ENR = 0x00000000;
	RCC->CR |= 0x00000001;     //使能内部高速时钟HSION

	RCC->CFGR &= 0xF8FF0000;   //复位SW[1:0],HPRE[3:0],PPRE1[2:0],PPRE2[2:0],ADCPRE[1:0],MCO[2:0]
	RCC->CR &= 0xFEF6FFFF;     //复位HSEON,CSSON,PLLON
	RCC->CR &= 0xFFFBFFFF;     //复位HSEBYP
	RCC->CFGR &= 0xFF80FFFF;   //复位PLLSRC, PLLXTPRE, PLLMUL[3:0] and USBPRE
	while(((RCC->CFGR>>2)& 0x03 )!=0x00);
	RCC->CIR = 0x00000000;     //关闭所有中断
	//配置向量表

//	SCB->VTOR = 0x08000000|(0x0 & (u32)0x1FFFFF80);//设置NVIC的向量表偏移寄存器

 	RCC->CR|=0x00010000;  //外部高速时钟使能HSEON
	while(((RCC->CR>>17)&0x00000001)==0);//等待外部时钟就绪
	RCC->CFGR=0X00000400; //APB1=DIV2;APB2=DIV1;AHB=DIV1;
	PLL-=2;//抵消2个单位
	RCC->CFGR|=PLL<<18;   //设置PLL值 2~16
	RCC->CFGR|=1<<16;	  //PLLSRC ON


	RCC->CR|=0x01000000;  //PLLON
	while(!(RCC->CR>>25));//等待PLL锁定
	RCC->CFGR|=0x00000002;//PLL作为系统时钟
	while(((RCC->CFGR>>2)&0x03)!=0x02);   //等待PLL作为系统时钟设置成功


}

void IO_init(void)
{
	RCC->APB2ENR|=1<<3;    //使能PORTB时钟
	GPIOB->MODER&=0X000FFFFF;				//将B56口配置为通用推挽输出,最大50MH
	GPIOB->MODER|=0X03300000;
	GPIOB->ODR=0XFFFF;
}
void _delay_us(unsigned int _us_time)
{
  unsigned char x=0;
  for(;_us_time>0;_us_time--)
  {
    x++;x++;x++;x++;x++;x++;x++;x++;x++;x++;x++;x++;
	  x++;x++;x++;x++;x++;x++;x++;x++;x++;x++;x++;x++;

  }
}

void delay_ms(unsigned int _ms_time)
  {
    unsigned int i,j;
    for(i=0;i<_ms_time;i++)
    {
    for(j=0;j<900;j++)
      {;}
    }
  }

/**************************IIC模块发送函数************************************************

 *************************************************************************/
//写入  最后将SDA拉高，以等待从设备产生应答
void IIC_write(unsigned char date)
{
	unsigned char i, temp;
	temp = date;

	for(i=0; i<8; i++)
	{	IIC_SCK_0;

        if ((temp&0x80)==0)
            IIC_SDA_0;
        else IIC_SDA_1;
		temp = temp << 1;
		_delay_us(1);
		IIC_SCK_1;
		_delay_us(1);

	}
	IIC_SCK_0;
	_delay_us(1);
	IIC_SDA_1;
	_delay_us(1);
	IIC_SCK_1;
//								不需要应答
//	if (READ_SDA==0)
//		ACK = 1;
//	else ACK =0;
	_delay_us(1);
	IIC_SCK_0;
	_delay_us(1);


}
//启动信号
//SCL在高电平期间，SDA由高电平向低电平的变化定义为启动信号
void IIC_start()
{
	IIC_SDA_1;
	_delay_us(1);
	IIC_SCK_1;
	_delay_us(1);				   //所有操作结束释放SCL
	IIC_SDA_0;
	_delay_us(3);
	IIC_SCK_0;

        IIC_write(0x7E);

}

//停止信号
//SCL在高电平期间，SDA由低电平向高电平的变化定义为停止信号
void IIC_stop()
{
	IIC_SDA_0;
	_delay_us(1);
	IIC_SCK_1;
	_delay_us(3);
	IIC_SDA_1;

}

void LCD_send_cmd(unsigned char o_command)
  {

    IIC_start();
    IIC_write(0x00);
    IIC_write(o_command);
    IIC_stop();

  }
void LCD_send_data(unsigned char o_data)
  {
    IIC_start();
    IIC_write(0x40);
    IIC_write(o_data);
    IIC_stop();
   }
void Column_set(unsigned char column)
  {
	column+=LCD_COLUMN_OFFSET;
    LCD_send_cmd(0x10|(column>>4));    //设置列地址高位
    LCD_send_cmd(0x00|(column&0x0f));   //设置列地址低位

  }
void Page_set(unsigned char page)
  {
    LCD_send_cmd(0xb0+page);
  }
void LCD_clear(void)
  {
    unsigned char page,column;
    for(page=0;page<LCD_PAGE_NUMBER;page++)             //page loop
      {
          Page_set(page);
          Column_set(0);
          for(column=0;column<LCD_COLUMN_NUMBER;column++)	//column loop
            {
              LCD_send_data(0x00);
            }
      }
  }
void LCD_full(void)
  {
    unsigned char page,column;
    for(page=0;page<LCD_PAGE_NUMBER;page++)             //page loop
      {
        Page_set(page);
        Column_set(0);
	for(column=0;column<LCD_COLUMN_NUMBER;column++)	//column loop
          {
            LCD_send_data(0xff);
          }
      }
  }
void LCD_init(void)
  {
    unsigned char i;
    for(i=0;i<LCD_COMMAND_NUMBER;i++)
      {
        LCD_send_cmd(LCD_init_cmd[i]);
      }
  }

void Picture_display(const unsigned char *ptr_pic)
  {
    unsigned char page,column;
    for(page=0;page<(LCD_LINE_NUMBER/8);page++)        //page loop
      {
	Page_set(page);
	Column_set(0);
	for(column=0;column<LCD_COLUMN_NUMBER;column++)	//column loop
          {
            LCD_send_data(*ptr_pic++);
          }
      }
  }
void Picture_ReverseDisplay(const unsigned char *ptr_pic)
{
    unsigned char page,column,data;
    for(page=0;page<(LCD_LINE_NUMBER/8);page++)        //page loop
      {
	Page_set(page);
	Column_set(0);
	for(column=0;column<LCD_COLUMN_NUMBER;column++)	//column loop
          {
            data=*ptr_pic++;
            data=~data;
            LCD_send_data(data);
          }
      }
  }

int address = 0;

void core(void) {
	bool flag = true;
	// U8G2_ST7567_JLX12864_1_HW_I2C u8g2(U8G2_R0);
	// u8g2.setFont(u8g2_font_DigitalDiscoThin_tf);
	// u8g2.begin();

    SYS_init(8);
  IO_init();

	LCD_init();
	LCD_full();
	delay_ms(1000);
	LCD_clear();
	while(true) {
		// HAL_GPIO_WritePin(LED_GPIO_Port,LED_Pin,GPIO_PIN_RESET);
		// if (flag) {
		// 	uint8_t addr = 0;
		// 	for (;addr < 0x80; addr++) {
		// 		HAL_StatusTypeDef state = HAL_I2C_Master_Transmit(&hi2c1, addr, (uint8_t*)"asdlkjfasdfiozcxvhkjasdhkje", 28, 1000);
		// 		switch (state) {
		// 			case HAL_OK:
		// 			HAL_GPIO_WritePin(LED_GPIO_Port,LED_Pin,GPIO_PIN_SET);
		// 			// flag = false;
		// 			address = addr;
		// 			break;
		// 			case HAL_BUSY:
		// 			;
		// 			HAL_GPIO_WritePin(LED_GPIO_Port,LED_Pin,GPIO_PIN_SET);
		// 			break;
		// 			case HAL_TIMEOUT:
		// 			;
		// 			HAL_GPIO_WritePin(LED_GPIO_Port,LED_Pin,GPIO_PIN_SET);
		// 			break;
		// 			default:
		// 			;
		// 			break;
		// 		}
		// 	}
		// }
		// u8g2.drawBox(0,0,20,20);
		// u8g2.drawBox(20,20,20,20);
		// u8g2.sendBuffer();
		// u8g2.drawFrame(10,40,20,20);
		// u8g2.drawStr(10, 20, "123");
		// u8g2.clear();
		// u8g2.clearBuffer();
		// u8g2.drawStr(0,10,(char*)(uart1_rxbuf+0));
		// u8g2.drawStr(0,25,(char*)(uart1_rxbuf+15));
		// u8g2.drawStr(0,40,(char*)(uart1_rxbuf+30));
		// u8g2.drawStr(0,55,(char*)(uart1_rxbuf+45));
		// u8g2.sendBuffer();
		Picture_display(picture_tab);
		delay_ms(5000);

		Picture_ReverseDisplay(picture_tab);
		delay_ms(5000);
		LCD_clear();
		// HAL_GPIO_TogglePin(LED_GPIO_Port, LED_Pin);
		// HAL_Delay(500);
	}

}
